## meta-bbb-kernel-dev/conf/layer.conf
```bitbake
# We have a conf and classes directory, append to BBPATH
BBPATH .= ":${LAYERDIR}"

# We have a recipes directory, add to BBFILES
BBFILES += "${LAYERDIR}/recipes*/*/*.bb ${LAYERDIR}/recipes*/*/*.bbappend"

BBFILE_COLLECTIONS += "meta-bbb-kernel-dev"
BBFILE_PATTERN_meta-bbb-kernel-dev := "^${LAYERDIR}/"
LAYERDEPENDS_meta-bbb-kernel-dev = "meta-ti"

LAYERSERIES_COMPAT_meta-bbb-kernel-dev = "warrior"

LICENSE_PATH += "${LAYERDIR}/licenses"
```

## meta-bbb-kernel-dev/conf/machine/beaglebone-container.conf
```bitbake
require conf/machine/beaglebone.conf

PREFERRED_PROVIDER_virtual/kernel = "linux-dummy"

MACHINE_ESSENTIAL_EXTRA_RDEPENDS = ""

IMAGE_INSTALL_remove = " kernel-devicetree kernel-image-zimage"
```

## meta-bbb-kernel-dev/conf/machine/beagleboneblack.conf
```bitbake
require conf/machine/include/beaglebone.conf

PREFERRED_PROVIDER_virtual/kernel = "linux-stable"
```
